#include "fortemis.dtsi"

&default_transform {
    col-offset = <18>;
};

&kscan0 {
    // begin: generated by ergogen/tools/zmk.py
    input-gpios
        = <&gpio1 15 (GPIO_ACTIVE_LOW | GPIO_PULL_UP)>  //  5 top inner      D10
        , <&gpio0 10 (GPIO_ACTIVE_LOW | GPIO_PULL_UP)>  //  6 top index      D15
        , <&gpio1 12 (GPIO_ACTIVE_LOW | GPIO_PULL_UP)>  //  7 top middle     D7
        , <&gpio1 11 (GPIO_ACTIVE_LOW | GPIO_PULL_UP)>  //  8 top ring       D6
        , <&gpio1  1 (GPIO_ACTIVE_LOW | GPIO_PULL_UP)>  //  9 top pinky      D13
        , <&gpio0 28 (GPIO_ACTIVE_LOW | GPIO_PULL_UP)>  // 15 home inner     D2
        , <&gpio1 14 (GPIO_ACTIVE_LOW | GPIO_PULL_UP)>  // 16 home index     D9
        , <&gpio1  3 (GPIO_ACTIVE_LOW | GPIO_PULL_UP)>  // 17 home middle    D17
        , <&gpio0  5 (GPIO_ACTIVE_LOW | GPIO_PULL_UP)>  // 18 home ring      D5
        , <&gpio0 29 (GPIO_ACTIVE_LOW | GPIO_PULL_UP)>  // 19 home pinky     D3
        , <&gpio0 19 (GPIO_ACTIVE_LOW | GPIO_PULL_UP)>  // 25 bottom inner   D12
        , <&gpio1  7 (GPIO_ACTIVE_LOW | GPIO_PULL_UP)>  // 26 bottom index   D19
        , <&gpio1 13 (GPIO_ACTIVE_LOW | GPIO_PULL_UP)>  // 27 bottom middle  D8
        , <&gpio0  4 (GPIO_ACTIVE_LOW | GPIO_PULL_UP)>  // 28 bottom ring    D4
        , <&gpio0  9 (GPIO_ACTIVE_LOW | GPIO_PULL_UP)>  // 29 bottom pinky   D14
        , <&gpio0  2 (GPIO_ACTIVE_LOW | GPIO_PULL_UP)>  // 33 far thumb      D0
        , <&gpio0 15 (GPIO_ACTIVE_LOW | GPIO_PULL_UP)>  // 34 near thumb     D11
        , <&gpio0  3 (GPIO_ACTIVE_LOW | GPIO_PULL_UP)>  // 35 tuck thumb     D1
        ;
    // end: generated
};

// D14 and D15 are the XIAO Plus pads on the nRF52840's NFC antenna pins
// (P0.09, P0.10), which only work as GPIOs with NFC turned off. The first boot
// after flashing writes this to the chip's UICR and restarts once.
&uicr {
    nfct-pins-as-gpios;
};

// D6 and D7, the XIAO's UART pins, carry keys. ZMK's XIAO board files already
// turn the UART off; this keeps it that way. It lives in the half overlays
// rather than fortemis.dtsi because the dongle also includes fortemis.dtsi, and
// it is a nice!nano with no xiao_serial node.
&xiao_serial {
    status = "disabled";
};
