#include "fortemis.dtsi"

&kscan0 {
    // begin: generated by ergogen/tools/zmk.py
    input-gpios
        = <&gpio1 15 (GPIO_ACTIVE_LOW | GPIO_PULL_UP)>  //  0 top pinky      D10
        , <&gpio1  3 (GPIO_ACTIVE_LOW | GPIO_PULL_UP)>  //  1 top ring       D17
        , <&gpio1 12 (GPIO_ACTIVE_LOW | GPIO_PULL_UP)>  //  2 top middle     D7
        , <&gpio0  4 (GPIO_ACTIVE_LOW | GPIO_PULL_UP)>  //  3 top index      D4
        , <&gpio1  1 (GPIO_ACTIVE_LOW | GPIO_PULL_UP)>  //  4 top inner      D13
        , <&gpio1  7 (GPIO_ACTIVE_LOW | GPIO_PULL_UP)>  // 10 home pinky     D19
        , <&gpio1 13 (GPIO_ACTIVE_LOW | GPIO_PULL_UP)>  // 11 home ring      D8
        , <&gpio1 11 (GPIO_ACTIVE_LOW | GPIO_PULL_UP)>  // 12 home middle    D6
        , <&gpio0  9 (GPIO_ACTIVE_LOW | GPIO_PULL_UP)>  // 13 home index     D14
        , <&gpio0 28 (GPIO_ACTIVE_LOW | GPIO_PULL_UP)>  // 14 home inner     D2
        , <&gpio1 14 (GPIO_ACTIVE_LOW | GPIO_PULL_UP)>  // 20 bottom pinky   D9
        , <&gpio1  5 (GPIO_ACTIVE_LOW | GPIO_PULL_UP)>  // 21 bottom ring    D18
        , <&gpio0  5 (GPIO_ACTIVE_LOW | GPIO_PULL_UP)>  // 22 bottom middle  D5
        , <&gpio0 29 (GPIO_ACTIVE_LOW | GPIO_PULL_UP)>  // 23 bottom index   D3
        , <&gpio0 19 (GPIO_ACTIVE_LOW | GPIO_PULL_UP)>  // 24 bottom inner   D12
        , <&gpio0  3 (GPIO_ACTIVE_LOW | GPIO_PULL_UP)>  // 30 tuck thumb     D1
        , <&gpio0 15 (GPIO_ACTIVE_LOW | GPIO_PULL_UP)>  // 31 near thumb     D11
        , <&gpio0  2 (GPIO_ACTIVE_LOW | GPIO_PULL_UP)>  // 32 far thumb      D0
        ;
    // end: generated
};

// D14 and D15 are the XIAO Plus pads on the nRF52840's NFC antenna pins
// (P0.09, P0.10), which only work as GPIOs with NFC turned off. The first boot
// after flashing writes this to the chip's UICR and restarts once.
&uicr {
    nfct-pins-as-gpios;
};

// D6 and D7, the XIAO's UART pins, carry keys. ZMK's XIAO board files already
// turn the UART off; this keeps it that way. It lives in the half overlays
// rather than fortemis.dtsi because the dongle also includes fortemis.dtsi, and
// it is a nice!nano with no xiao_serial node.
&xiao_serial {
    status = "disabled";
};
